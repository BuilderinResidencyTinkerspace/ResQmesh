## code/ESP32-DRONE/sdkconfig.defaults
```kconfig
# ESP32-S3 Quadcopter Flight Controller sdkconfig.defaults
# Target ESP32-S3
CONFIG_IDF_TARGET="esp32s3"

# CPU Frequency: 240 MHz for high performance flight loop
CONFIG_ESP_DEFAULT_CPU_FREQ_MHZ_240=y
CONFIG_ESP_DEFAULT_CPU_FREQ_MHZ=240

# FreeRTOS Tick Rate: 1000 Hz (1 ms resolution for precise timing)
CONFIG_FREERTOS_HZ=1000

# Watchdog timers
CONFIG_ESP_INT_WDT=y
CONFIG_ESP_INT_WDT_TIMEOUT_MS=300
CONFIG_ESP_TASK_WDT=y
CONFIG_ESP_TASK_WDT_TIMEOUT_S=2

# Compiler optimization for performance
CONFIG_COMPILER_OPTIMIZATION_PERF=y

# Enable Floating Point Unit
CONFIG_FREERTOS_FPU_IN_ISR=y

# Wi-Fi / ESP-NOW configuration
CONFIG_ESP_WIFI_STATIC_RX_BUFFER_NUM=10
CONFIG_ESP_WIFI_DYNAMIC_RX_BUFFER_NUM=32
CONFIG_ESP_WIFI_TX_BUFFER_TYPE=1
CONFIG_ESP_WIFI_DYNAMIC_TX_BUFFER_NUM=32
CONFIG_ESP_WIFI_AMPDU_TX_ENABLED=n
CONFIG_ESP_WIFI_AMPDU_RX_ENABLED=n

# Common configuration
CONFIG_LOG_DEFAULT_LEVEL_INFO=y
```
